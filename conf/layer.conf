## conf/layer.conf
```bitbake
# We have a conf and classes directory, add to BBPATH
BBPATH .= ":${LAYERDIR}"

# Add recipes to to BBFILES
BBFILES += " ${LAYERDIR}/recipes-*/*/*.bb "
BBFILES += " ${LAYERDIR}/recipes-*/*/*.bbappend* "

BBFILE_COLLECTIONS += "x-linux-qt-myir"
BBFILE_PATTERN_x-linux-qt-myir := "^${LAYERDIR}/"
BBFILE_PRIORITY_x-linux-qt-myir = "7"

# This should only be incremented on significant changes that will
# cause compatibility issues with other layers
LAYERVERSION_x-linux-qt-myir = "1"
LAYERSERIES_COMPAT_x-linux-qt-myir = "kirkstone mickledore scarthgap"

LAYERDEPENDS_x-linux-qt-myir  = "myir-stm32mp"
LAYERDEPENDS_x-linux-qt-myir += "myir-openstlinux"

# OpenSTLinux compatibility version
ST_OSTL_COMPATIBILITY_VERSION_myir-stm32mp = "6.1"

# =========================================================================
# QT development tools and framework version and license selection
# =========================================================================
# Default to opensource Qt 6.x version
QT_VERSION ?= "6.x"
QT_EDITION ?= "opensource"
```
